## config/west.yml
```yaml
manifest:
  remotes:
    - name: zmkfirmware
      url-base: https://github.com/zmkfirmware
    - name: ubesluttsom
      url-base: https://github.com/ubesluttsom
  projects:
    - name: zmk
      remote: ubesluttsom
      revision: main
      import: app/west.yml
  self:
    path: config
```
